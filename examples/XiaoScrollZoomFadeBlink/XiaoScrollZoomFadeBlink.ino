// XiaoScrollZoomFadeBlink.ino
// Written for Xia Development Board
// But will work for any Arduino with SSD1306 at 0x3C and button on pin 1
// Cycle through the various effects by pushing the button

#include <SPI.h>
#include <Wire.h>
#include <Adafruit_GFX.h>
#include <Adafruit_SSD1306Plus.h>

#define SCREEN_WIDTH 128  // OLED display width, in pixels
#define SCREEN_HEIGHT 64  // OLED display height, in pixels

// Declaration for an SSD1306 display connected to I2C (SDA, SCL pins)
// The pins for I2C are defined by the Wire-library.
// On an arduino UNO:       A4(SDA), A5(SCL)
// On an arduino MEGA 2560: 20(SDA), 21(SCL)
// On an arduino LEONARDO:   2(SDA),  3(SCL), ...
#define OLED_RESET -1        // Reset pin # (or -1 if sharing Arduino reset pin)
#define SCREEN_ADDRESS 0x3C  ///< See datasheet for Address; 0x3D for 128x64, 0x3C for 128x32
Adafruit_SSD1306Plus display(SCREEN_WIDTH, SCREEN_HEIGHT, &Wire, OLED_RESET);

#define LOGO_HEIGHT 64
#define LOGO_WIDTH 128

// Generated from https://javl.github.io/image2cpp/
// 'StarWarsLandscape', 128x64px
const unsigned char epd_bitmap_StarWarsLandscape_WonB[] PROGMEM = {
  0x00, 0x00, 0x00, 0x00, 0x00, 0x00, 0x00, 0x00, 0x00, 0x00, 0x00, 0x00, 0x00, 0x00, 0x00, 0x00,
  0x00, 0x00, 0x3e, 0x00, 0x00, 0x00, 0x00, 0x00, 0x00, 0x00, 0x00, 0x00, 0x00, 0x00, 0x00, 0x00,
  0x00, 0x00, 0x73, 0x00, 0x00, 0x00, 0x00, 0x00, 0x00, 0x00, 0x00, 0x00, 0x00, 0x00, 0x00, 0x00,
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  0x00, 0x00, 0x00, 0x00, 0x00, 0x00, 0x00, 0x00, 0x00, 0x00, 0x00, 0x00, 0x00, 0x00, 0x00, 0x00
};

const int buttonPin = 1;  // the number of the pushbutton pin
int buttonState = 0;      // variable for reading the pushbutton status
bool toggle = false;
bool bDisplay = true;    // true is landscape, false is zoom
int iDisplay = 0;        // 2 is fade, 1 is zoom, 0 is scroll
const int cMaxList = 3;  // 3 is blink, 2 is fade, 1 is zoom, 0 is scroll


void setup() {

  // initialize the pushbutton pin as an input:
  pinMode(buttonPin, INPUT_PULLUP);


  Serial.begin(9600);

  // by default, we'll generate the high voltage from the 3.3v line internally! (neat!)
  //display.begin(SSD1306_SWITCHCAPVCC);  // Waaay too basic
  // SSD1306_SWITCHCAPVCC = generate display voltage from 3.3V internally
  if (!display.begin(SSD1306_SWITCHCAPVCC, SCREEN_ADDRESS)) {
    Serial.println(F("SSD1306 allocation failed"));
    for (;;)
      ;  // Don't proceed, loop forever
  }
  // init done

  // Stop scroll, fade, blink and zoom
  display.stopFadeBlink();
  display.stopscroll();
  display.stopZoom();
  // Clear the buffer.
  display.clearDisplay();

  // bitmap display
  display.drawBitmap(0, 0, epd_bitmap_StarWarsLandscape_WonB, 128, 64, 1);
  display.display();

  //display.stopscroll();  // Not strictly needed as no scrolling occurring yet...
  // but good practice to call before new scroll commands
}

void loop() {
  // read the state of the pushbutton value:
  //buttonState = digitalRead(buttonPin);

  // check if the pushbutton is pressed. If it is, the buttonState is LOW:
  //if (buttonState == LOW) {
  if (digitalRead(buttonPin) == LOW) {
    // turn LED on:
    digitalWrite(LED_BUILTIN, LOW);
    //toggle = true;
    //DoToggle();
    DoToggleCase();
    /*
    bDisplay = !bDisplay;

    if (bDisplay) {
      // Clear the buffer.
      display.clearDisplay();

      // bitmap display
      display.drawBitmap(0, 0, epd_bitmap_StarWarsLandscape_WonB, 128, 64, 1);
      display.display();
    } else {
      // Clear the buffer.
      display.clearDisplay();
      testdrawstyles();

      display.display();
    }
    delay(500);
*/
  } else {
    // turn LED off:
    digitalWrite(LED_BUILTIN, HIGH);
  }

  /*
  if (toggle) {
    bDisplay = !bDisplay;
    toggle = false;

    //delay(2000);

    if (bDisplay) {
      // Clear the buffer.
      display.clearDisplay();

      // bitmap display
      display.drawBitmap(0, 0, epd_bitmap_StarWarsLandscape_WonB, 128, 64, 1);
      display.display();
    } else {
      // Clear the buffer.
      display.clearDisplay();
      testdrawstyles();

      display.display();
    }
  }
  */
  //DoDisplayAction();
  DoDisplayActionCase();
  /*
  if (bDisplay)
    scroll_landscape();
  else
    testzoom();
  */
}

void DoToggle(void) {
  bDisplay = !bDisplay;

  if (bDisplay) {
    // Clear the buffer.
    display.clearDisplay();
    // bitmap display
    display.drawBitmap(0, 0, epd_bitmap_StarWarsLandscape_WonB, 128, 64, 1);
    display.display();
  } else {
    // Clear the buffer.
    display.clearDisplay();
    testdrawstyles();

    display.display();
  }
  delay(500);
}

void DoToggleCase(void) {
  iDisplay++;
  if (iDisplay > cMaxList)
    iDisplay = 0;

  switch (iDisplay) {
    case 0:
      // Clear the buffer.
      display.clearDisplay();
      // bitmap display
      display.drawBitmap(0, 0, epd_bitmap_StarWarsLandscape_WonB, 128, 64, 1);
      display.display();
      break;
    case 1:
    case 2:
    case 3:

      // Clear the buffer.
      display.clearDisplay();
      testdrawstyles();

      display.display();
      break;
    default:
      break;
  }
  delay(500);
}

void DoDisplayAction(void) {
  if (bDisplay)
    scroll_landscape();
  else
    testzoom();
}

void DoDisplayActionCase(void) {
  switch (iDisplay) {
    case 0:
      scroll_landscape();
      break;
    case 1:
      testzoom();
      break;
    case 2:
      testfade();
      break;
    case 3:
      testblink();
      break;
    default:
      break;
  }
}

void scroll_landscape(void) {

  int wait_time = 12;  // For the Xiao: 15 is the minimum (maybe 12... but definitely not 11)

  for (int j = 0; j < 2; j++) {
    for (int i = 0; i < 2; i++) {
      display.startscrollleftone(0x06, 0x07);
      delay(wait_time);
    }
    display.startscrollleftone(0x03, 0x05);
    delay(wait_time);
  }
  display.startscrollleftone(0x00, 0x02);
  delay(wait_time);
}

void testdrawstyles(void) {
  display.clearDisplay();

  display.setTextSize(1);               // Normal 1:1 pixel scale
  display.setTextColor(SSD1306_WHITE);  // Draw white text
  display.setCursor(0, 0);              // Start at top-left corner
  display.println(F("Hello, world!"));

  display.setTextColor(SSD1306_BLACK, SSD1306_WHITE);  // Draw 'inverse' text
  display.println(3.141592);

  display.setTextSize(2);  // Draw 2X-scale text
  display.setTextColor(SSD1306_WHITE);
  display.print(F("0x"));
  if (iDisplay == 2) {
    display.println(0xDEADFADE, HEX);
  } else if (iDisplay == 3) {
    display.println(0xDEADBBBB, HEX);
  } else {
    display.println(0xDEADBEEF, HEX);
  }

  display.display();
  delay(2000);
}

void testzoom(void) {

  display.setZoom(true);
  delay(2000);

  display.setZoom(false);
  delay(2000);
}

void testfade(void) {
  display.fade(0);
  delay(2000);

  display.stopFade();
  delay(2000);
}

void testblink(void) {
  display.blink(0);
  delay(2000);

  display.stopBlink();
  delay(2000);
}
